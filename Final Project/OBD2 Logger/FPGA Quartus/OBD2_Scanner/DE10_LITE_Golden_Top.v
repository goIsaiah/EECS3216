// ============================================================================
//   Ver  :| Author          :| Mod. Date :| Changes Made:
//   V1.2 :| Isaiah & Evan   :| 04/20/2025:| Fixed UART GPIO pin direction
// ============================================================================

//============================================================
//  System Configuration Generated by Terasic System Builder
//============================================================

`define ENABLE_ADC_CLOCK
`define ENABLE_CLOCK1
`define ENABLE_CLOCK2
`define ENABLE_SDRAM
`define ENABLE_HEX0
`define ENABLE_HEX1
`define ENABLE_HEX2
`define ENABLE_HEX3
`define ENABLE_HEX4
`define ENABLE_HEX5
`define ENABLE_KEY
`define ENABLE_LED
`define ENABLE_SW
`define ENABLE_VGA
`define ENABLE_ACCELEROMETER
`define ENABLE_ARDUINO
`define ENABLE_GPIO

module DE10_LITE_Golden_Top(
    // CLOCK INPUTS
`ifdef ENABLE_CLOCK1
    input wire MAX10_CLK1_50,
`endif

	//////////// SEG7: 3.3-V LVTTL //////////
`ifdef ENABLE_HEX0
	output		     [7:0]		HEX0,
`endif
`ifdef ENABLE_HEX1
	output		     [7:0]		HEX1,
`endif
`ifdef ENABLE_HEX2
	output		     [7:0]		HEX2,
`endif
`ifdef ENABLE_HEX3
	output		     [7:0]		HEX3,
`endif
`ifdef ENABLE_HEX4
	output		     [7:0]		HEX4,
`endif
`ifdef ENABLE_HEX5
	output		     [7:0]		HEX5,
`endif

`ifdef ENABLE_KEY
    input wire [1:0] KEY,  // Push buttons
`endif

`ifdef ENABLE_LED
    output wire [9:0] LEDR, // Debugging LEDs
`endif

	//////////// Arduino: 3.3-V LVTTL //////////
`ifdef ENABLE_ARDUINO
	inout 		    [15:0]		ARDUINO_IO,
	inout 		          		ARDUINO_RESET_N,
`endif

`ifdef ENABLE_GPIO
    input  wire GPIO_33,  // UART RX (input from Arduino)
    output wire GPIO_35   // UART TX (output to Arduino)
`endif
);

//=======================================================
//  Structural coding
//=======================================================

reg [7:0] buffered_data[5:0];  // Buffer to store 6 bytes
reg [7:0] temp_data[5:0];  // Buffer to store 11 bytes
reg [2:0] index = 0;           // Tracks current position in the buffer
reg [2:0] previous_index = 0;	// index - 1 with rollever
reg [2:0] offset = 0;	// index to start of data
wire data_valid;                // Signal that new data is available
wire [7:0] received_data;       // Incoming UART byte
wire [9:0] byte_count;
reg state = 0; // FSM: 0=Find offset, 1=receive data

// Instantiate UART Receiver
uart_receiver OBD2_data(.clk(MAX10_CLK1_50), .rx(GPIO_33), .received_data(received_data), .DTR(data_valid), .byte_count(byte_count));

// Buffer Incoming Data.
// After 11 bytes have been buffered, one useful 6 byte sequence is guaranteed
always @(posedge MAX10_CLK1_50) begin
    if (data_valid) begin
		case (state)
			0: begin
				index <= byte_count % 6;
				temp_data[index] <= received_data;
				previous_index <= (index == 0) ? 5 : index -1;
				if (received_data == 255 && temp_data[previous_index] == 255) begin
					offset <= previous_index; // offset found
					state <= 1;
				end
			end
			1: buffered_data[(byte_count-offset) % 6] = received_data;
		endcase
	 end
end

light_number tach({buffered_data[2], buffered_data[3]}, MAX10_CLK1_50, LEDR);
LED_number speed(buffered_data[4], HEX0, HEX1, HEX2);
LED_number load(buffered_data[5], HEX3, HEX4, HEX5);

endmodule
